
#include "Glcd12864.h"

int contadorx=0;
int contadory= 0;
float pot=0;
int pot2=0;
int potfinal = 30;
float conver = 0;
int cont_bpm=0;
int seg = 0;
int bmp2 =0;
int bandera = 0;



const unsigned char Imagen[1024]={ // Vector constante con imagen codificada
0x00,0x00,0x00,0x00,0x00,0x80,0xC0,0xE0,0xF0,0xF0,0xF8,0x78,0x7C,0x7C,0x3C,0x3C,
0x3C,0x3C,0x3C,0x3C,0x7C,0x78,0xF8,0xF8,0xF0,0xE0,0xE0,0xC0,0x80,0x00,0x00,0x00,
0x00,0x00,0x00,0x00,0x00,0x00,0x00,0x00,0x80,0xC0,0xE0,0xF0,0xF0,0xF8,0xF8,0x7C,
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0x01,0x01,0x01,0x01,0x01,0x01,0x01,0x01,0x01,0x00,0x00,0x00,0x00,0x00,0x00,0x00
};

GLcd12864 L; // Declaración del objeto Lcd


//Coeficientes filtro de kalman

float q=1.0; //Ruido del proceso
float r=0.00565; // Ruido de la medición
float x_est =5 ; //estimación inicial
float p_est = 0.1; // incertidumbre inicial

void kalman(void) {
	
	//Predice el dato
	float x_pred = x_est;
	float p_pred= p_est+q;
	
	//Actualización dato
	float k= p_pred/(p_pred+r);
	float x_updated = x_pred +k*(conver-x_pred);
	float p_updated = (1-k) * p_pred;
	
	x_est=x_updated;
	p_est=p_updated;
}

 extern "C"{
	void SysTick_Handler(void){
		seg++;
		if(seg >= 15){
		 bandera = 1;
	   seg = 0;
		}else{bandera = 0;}
				
	}
}

int main(void){ // Función principal Main 
 // Inicia GLCD por los pines del puerto Arduino 
 L.IniciarGLCD(DP9,DP8,AP1,AP0,DP12,DP11,DP10,DP2,DP3,DP4,DP5,DP6,DP7); 
	
	RCC -> AHB1ENR |= 0X7;
	GPIOB-> MODER |= 0XC;     //0000 1100
	GPIOC-> MODER |= 0X30;     //0011 0000
	//CONFIGURAR ADC
	RCC -> APB2ENR |= (1UL<<14);
	RCC -> APB2ENR |= 0x100;				//Habilitar el ADC1
	GPIOB -> MODER|= 0XC; //0000 0000 1100
	
	ADC1->CR1|=0;
	ADC1->SQR3=9	;//activa canal 9 osea B1
	ADC1->CR2=0;//desactivar conversion T1
	Delay_ms(100);//esperar
	ADC1->CR2=1;//activa conversion
	
  SystemCoreClockUpdate();
	SysTick_Config(SystemCoreClock);
	 
	
 while(1){ // Bucle infinito 
	 L.PrintTexto(1,54,"BPM: ");
	 pot2 = potfinal;
	 ADC1->CR2|=0X40000000; //inicia conversion en canales regulares
		while((ADC1->SR &0X2)==1){asm("nop");}
		conver = ADC1 -> DR;
		kalman();
//		pot = ((x_est/4095.0)*50);
		pot = ((conver/4095.0)*50);
    if(pot>=40.0){ pot = pot+10;}
		potfinal = 50-pot;
	  contadorx+=2;contadory++;
		//Delay_ms(1);
		if(pot>39){cont_bpm++;}
		
		if(bandera ==1){
		  bmp2 = cont_bpm * 4;
			char unidad = ((bmp2*3)/10)+48;
		  char decena = ((bmp2*3)%10)+48;
			L.PrintChar(30,54,unidad);
			L.PrintChar(36,54,decena);
			Delay_ms(1000);
			cont_bpm = 0;
		}else{
			L.PrintChar(30,54,' ');
			L.PrintChar(36,54,' ');
		}
	  L.Linea(contadorx-2,pot2+5,contadorx,potfinal+5);
		//L.LineaP(contadorx-2,pot2+5,contadorx,potfinal+5,0);
	L.Refrescar();L.PrintChar(2,54,' ');// Refresca pantalla
	 if(contadorx>126){L.BorrarPantalla();contadorx=0;}
	 
	 
	 
 }
 return 0;
}


