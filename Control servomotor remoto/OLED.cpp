#include "OLED.h"
#define SSD1306_NORMALDISPLAY       0xA6
#define SSD1306_INVERTDISPLAY       0xA7
static char SSD1306_Buffer[SSD1306_WIDTH * SSD1306_HEIGHT / 8];

typedef struct {
	uint16_t CurrentX;
	uint16_t CurrentY;
	uint8_t Inverted;
	uint8_t Initialized;
} SSD1306_t;


void i2c_writeByte(char data){

while(I2C1->SR2&I2C_SR2_BUSY){;}         
I2C1->CR1|=I2C_CR1_START;                
while(!(I2C1->SR1&I2C_SR1_SB)){;}        
I2C1->DR = 0x78;                
while(!(I2C1->SR1&I2C_SR1_ADDR)){;}  
int Tempo = I2C1->SR1; 	
	  Tempo = I2C1->SR2; 	
while(!(I2C1->SR1&I2C_SR1_TXE)){;}      
I2C1->DR = 0;                        
while(!(I2C1->SR1&I2C_SR1_TXE)){;}     
I2C1->DR = data; 	
while (!(I2C1->SR1 & I2C_SR1_BTF));     
I2C1->CR1 |=I2C_CR1_STOP;								
	
}


void i2c_WriteMulti(char maddr,char *buffer, uint8_t length){
volatile int Tempo;
while (I2C1->SR2 & I2C_SR2_BUSY);           
I2C1->CR1 |= I2C_CR1_START;                   
while (!(I2C1->SR1 & I2C_SR1_SB)){;}															
I2C1->DR =0x78;                   	 			
while (!(I2C1->SR1 & I2C_SR1_ADDR)){;}       
Tempo = I2C1->SR2; 						                 
while (!(I2C1->SR1 & I2C_SR1_TXE));          
I2C1->DR = maddr;                      			
while (!(I2C1->SR1 & I2C_SR1_TXE));         
for (uint8_t i=0;i<length;i++) { 
 I2C1->DR=buffer[i]; 												
	while (!(I2C1->SR1 & I2C_SR1_BTF));
 }	
                            
I2C1->CR1 |= I2C_CR1_STOP;										
}
static SSD1306_t SSD1306;
void oled_Init(void) {
	i2c_writeByte(0xAE); 
	i2c_writeByte(0x20); 
	i2c_writeByte(0x10); 
	i2c_writeByte(0xB0); 
	i2c_writeByte(0xC8);
	i2c_writeByte(0x00); 
	i2c_writeByte(0x10); 
	i2c_writeByte(0x40);
	i2c_writeByte(0x81); 
	i2c_writeByte(0xFF);
	i2c_writeByte(0xA1); 
	i2c_writeByte(0xA6);
	i2c_writeByte(0xA8);
	i2c_writeByte(0x3F);
	i2c_writeByte(0xA4); 
	i2c_writeByte(0xD3); 
	i2c_writeByte(0x00); 
	i2c_writeByte(0xD5); 
	i2c_writeByte(0xF0); 
	i2c_writeByte(0xD9);
	i2c_writeByte(0x22); 
	i2c_writeByte(0xDA); 
	i2c_writeByte(0x12);
	i2c_writeByte(0xDB); 
	i2c_writeByte(0x20);
	i2c_writeByte(0x8D);
	i2c_writeByte(0x14); 
	i2c_writeByte(0xAF);
	i2c_writeByte(0x2E); 
	SSD1306_Fill(SSD1306_COLOR_BLACK);
	SSD1306_UpdateScreen();
}
void ssd1306_I2C_WriteMulti(uint8_t reg, char* data, uint16_t count) {
uint8_t dt[256];
uint8_t i;
for(i = 0; i < count; i++)
dt[i] = data[i];
i2c_WriteMulti(reg,data,count);
}
void SSD1306_UpdateScreen(void) {
	uint8_t m;
	
	for (m = 0; m < 8; m++) {
		i2c_writeByte(0xB0 + m);
		i2c_writeByte(0x00);
		i2c_writeByte(0x10);
		ssd1306_I2C_WriteMulti(0x40, &SSD1306_Buffer[SSD1306_WIDTH * m], SSD1306_WIDTH);
	}
}

void SSD1306_Fill(int color) {
	memset(SSD1306_Buffer, (color == SSD1306_COLOR_BLACK) ? 0x00 : 0xFF, sizeof(SSD1306_Buffer));
}

void SSD1306_GotoXY(uint16_t x, uint16_t y) {
	SSD1306.CurrentX = x;
	SSD1306.CurrentY = y;
}

void SSD1306_DrawPixel(uint16_t x, uint16_t y, int color) {
	if (
		x >= SSD1306_WIDTH ||
		y >= SSD1306_HEIGHT
	) {
		return;
	}

	if (SSD1306.Inverted) {
		color = !color;
	}

	if (color == SSD1306_COLOR_WHITE) {
		SSD1306_Buffer[x + (y / 8) * SSD1306_WIDTH] |= 1 << (y % 8);
	} else {
		SSD1306_Buffer[x + (y / 8) * SSD1306_WIDTH] &= ~(1 << (y % 8));
	}
}

char SSD1306_Putc(char ch, FontDef_t* Font, int color) {
	uint32_t i, b, j;

	if (
		SSD1306_WIDTH <= (SSD1306.CurrentX + Font->FontWidth) ||
		SSD1306_HEIGHT <= (SSD1306.CurrentY + Font->FontHeight)
	) {
		return 0;
	}
	for (i = 0; i < Font->FontHeight; i++) {
		b = Font->data[(ch - 32) * Font->FontHeight + i];
		for (j = 0; j < Font->FontWidth; j++) {
			if ((b << j) & 0x8000) {
				SSD1306_DrawPixel(SSD1306.CurrentX + j, (SSD1306.CurrentY + i),  color);
			} else {
				SSD1306_DrawPixel(SSD1306.CurrentX + j, (SSD1306.CurrentY + i), !color);
			}
		}
	}
	SSD1306.CurrentX += Font->FontWidth;
	return ch;
}

char SSD1306_Puts(char* str, FontDef_t* Font, int color) {
	while (*str) {
		if (SSD1306_Putc(*str, Font, color) != *str) {
			return *str;
		}
		str++;
	}
	return *str;
}

void SSD1306_Clear (void){
	SSD1306_Fill (0);
    SSD1306_UpdateScreen();
}
void SSD1306_ON(void) {
	i2c_writeByte(0x8D);  
	i2c_writeByte(0x14);  
	i2c_writeByte(0xAF);  
}
void SSD1306_OFF(void) {
	i2c_writeByte(0x8D);  
	i2c_writeByte(0x10);
	i2c_writeByte(0xAE);  
}


const uint16_t Font16x26 [] = {
0x0000,0x0000,0x0000,0x0000,0x0000,0x0000,0x0000,0x0000,0x0000,0x0000,0x0000,0x0000,0x0000,0x0000,0x0000,0x0000,0x0000,0x0000,0x0000,0x0000,0x0000,0x0000,0x0000,0x0000,0x0000,0x0000, // Ascii = [ ]
0x03E0,0x03E0,0x03E0,0x03E0,0x03E0,0x03E0,0x03E0,0x03E0,0x03C0,0x03C0,0x01C0,0x01C0,0x01C0,0x01C0,0x01C0,0x0000,0x0000,0x0000,0x03E0,0x03E0,0x03E0,0x0000,0x0000,0x0000,0x0000,0x0000, // Ascii = [!]
0x1E3C,0x1E3C,0x1E3C,0x1E3C,0x1E3C,0x1E3C,0x1E3C,0x0000,0x0000,0x0000,0x0000,0x0000,0x0000,0x0000,0x0000,0x0000,0x0000,0x0000,0x0000,0x0000,0x0000,0x0000,0x0000,0x0000,0x0000,0x0000, // Ascii = ["]
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0x0000,0x0000,0x0000,0x0000,0x0000,0x0000,0x0000,0x0000,0x0000,0x0000,0x0000,0x3F07,0x7FC7,0x73E7,0xF1FF,0xF07E,0x0000,0x0000,0x0000,0x0000,0x0000,0x0000,0x0000,0x0000,0x0000,0x0000, // Ascii = [~]
};




FontDef_t Font_16x26 = {
	16,
	26,
	Font16x26
};
